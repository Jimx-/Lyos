## drivers/usb/usbd/config.in
```kconfig
config USB_PCI
    bool "PCI based USB host interface"
    depends on PCI_DEV
    default y

config USB_OHCI_HCD
    tristate "OHCI HCD (USB 1.1) support"
    help
      The Open Host Controller Interface (OHCI) is a standard for accessing
      USB 1.1 host controller hardware.

if USB_OHCI_HCD

config USB_OHCI_HCD_PCI
    tristate "OHCI support for PCI-bus USB controllers"
    depends on USB_PCI
    default y
    help
      Enables support for PCI-bus plug-in USB controller cards.
      If unsure, say Y.

endif

config USB_XHCI_HCD
    tristate "xHCI HCD (USB 3.0) support"
    help
      The eXtensible Host Controller Interface (xHCI) is the standard for
      accessing USB 3.0 (SuperSpeed) host controller hardware. It also
      supports USB 2.0 and USB 1.1 devices.

if USB_XHCI_HCD

config USB_XHCI_HCD_PCI
    tristate "xHCI support for PCI-bus USB controllers"
    depends on USB_PCI
    default y
    help
      Enables support for PCI-bus plug-in USB 3.0 controller cards.
      If unsure, say Y.

endif

config USB_DWC2
    bool "DesignWare USB2 DRD Core Support"
    depends on USB
    depends on OF
    help
      Say Y here if your system has a Dual Role Hi-Speed USB
      controller based on the DesignWare HSOTG IP Core.
```

## servers/config.in
```kconfig
source "servers/mm/config.in"

config VMM
    bool "Userspace virtual machine monitor"
    depends on INTEL_VMX
    default y
    help
      Build and include the VMM service. The current architecture backend
      runs 32-bit x86 guests using the Intel VT-x kernel backend.
```
