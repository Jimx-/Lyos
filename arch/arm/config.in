## arch/arm/config.in
```kconfig
#
# For a description of the syntax of this configuration file,
# see documentation/config/kconfig-language.txt.
#

source "kernel/config.in"

source "drivers/config.in"

menu "Processor type and features"

config SMP
    bool "Symmetric multiprocessing"
    help
      Enable support for systems that have more than one processor.

config SMP_MAX_CPUS
    int "Max number of CPUs"
    depends on SMP
    default "8"
    help
      The default value is 8 CPUs.

endmenu

menu "System type"

choice
	prompt "ARM system type"
	default ARCH_MULTIPLATFORM

config ARCH_MULTIPLATFORM
	bool "Allow multiple platforms to be selected"

config ARCH_OMAP
	bool "TI OMAP"
	help
	  Support for TI's OMAP platform (OMAP1/2/3/4).

endchoice

source "kernel/arch/arm/plat-omap/config.in"
source "kernel/arch/arm/mach-omap2/config.in"

endmenu
```

## arch/arm64/config.in
```kconfig
#
# For a description of the syntax of this configuration file,
# see documentation/config/kconfig-language.txt.
#

config ARM64
    def_bool y
    select PHYS_BYTES_64BIT
    select OF
    help
      ARM 64-bit (AArch64) support.

config 64BIT
    def_bool y

config SMP
    def_bool y

config ARM64_PAGE_SHIFT
    int
    default 16 if ARM64_64K_PAGES
    default 14 if ARM64_16K_PAGES
    default 12

config PGTABLE_LEVELS
    int
    default 2 if ARM64_16K_PAGES && ARM64_VA_BITS_36
    default 2 if ARM64_64K_PAGES && ARM64_VA_BITS_42
    default 3 if ARM64_64K_PAGES && ARM64_VA_BITS_48
    default 3 if ARM64_4K_PAGES && ARM64_VA_BITS_39
    default 3 if ARM64_16K_PAGES && ARM64_VA_BITS_47
    default 4 if !ARM64_64K_PAGES && ARM64_VA_BITS_48

menu "Kernel features"

config SMP_MAX_CPUS
    int "Maximum number of CPUs (2-4096)"
    range 2 4096
    default "8"

endmenu

source "kernel/config.in"

source "drivers/config.in"

source "servers/config.in"

source "lib/config.in"

source "net/config.in"

menu "Platform type"

choice
    prompt "Page size"
    default ARM64_4K_PAGES
    help
      Page size (translation granule) configuration.

config ARM64_4K_PAGES
    bool "4KB"
    help
      This feature enables 4KB pages support.

config ARM64_16K_PAGES
    bool "16KB"
    help
      The system will use 16KB pages support. AArch32 emulation
      requires applications compiled with 16K (or a multiple of 16K)
      aligned segments.

config ARM64_64K_PAGES
    bool "64KB"
    help
      This feature enables 64KB pages support (4KB by default)
      allowing only two levels of page tables and faster TLB
      look-up. AArch32 emulation requires applications compiled
      with 64K aligned segments.

endchoice

choice
    prompt "Virtual address space size"
    default ARM64_VA_BITS_39 if ARM64_4K_PAGES
    default ARM64_VA_BITS_47 if ARM64_16K_PAGES
    default ARM64_VA_BITS_42 if ARM64_64K_PAGES
    help
      Allows choosing one of multiple possible virtual address
      space sizes. The level of translation table is determined by
      a combination of page size and virtual address space size.

config ARM64_VA_BITS_39
    bool "39-bit"
    depends on ARM64_4K_PAGES

config ARM64_VA_BITS_42
    bool "42-bit"
    depends on ARM64_64K_PAGES

config ARM64_VA_BITS_47
    bool "47-bit"
    depends on ARM64_16K_PAGES

config ARM64_VA_BITS_48
    bool "48-bit"

endchoice

config ARM64_VA_BITS
    int
    default 36 if ARM64_VA_BITS_36
    default 39 if ARM64_VA_BITS_39
    default 42 if ARM64_VA_BITS_42
    default 47 if ARM64_VA_BITS_47
    default 48 if ARM64_VA_BITS_48
    default 52 if ARM64_VA_BITS_52

choice
    prompt "Physical address space size"
    default ARM64_PA_BITS_48
    help
      Choose the maximum physical address range that the kernel will
      support.

config ARM64_PA_BITS_48
    bool "48-bit"

endchoice

config ARM64_PA_BITS
    int
    default 48 if ARM64_PA_BITS_48

endmenu

menu "System type"

source "kernel/arch/arm64/mach-bcm/config.in"

endmenu
```

## arch/riscv/config.in
```kconfig
#
# For a description of the syntax of this configuration file,
# see documentation/config/kconfig-language.txt.
#

config 64BIT
    bool

config 32BIT
    bool

config RISCV
    def_bool y
    select PHYS_BYTES_64BIT

config KERNEL_VMA
    hex
    default 0xC0000000 if 32BIT && MAXPHYSMEM_2GB
    default 0xffffffff80000000 if 64BIT && MAXPHYSMEM_2GB
    default 0xffffffe000000000 if 64BIT && MAXPHYSMEM_128GB

source "kernel/config.in"

source "drivers/config.in"

source "servers/config.in"

menu "Platform type"

choice
	prompt "Base ISA"
	default ARCH_RV64I
	help
	  This selects the base ISA that this kernel will traget and must match
	  the target platform.

config ARCH_RV32I
	bool "RV32I"
	select 32BIT

config ARCH_RV64I
	bool "RV64I"
	select 64BIT

endchoice

choice
  prompt "Kernel Code Model"
	default CMODEL_MEDLOW if 32BIT
	default CMODEL_MEDANY if 64BIT

	config CMODEL_MEDLOW
		bool "medium low code model"
	config CMODEL_MEDANY
		bool "medium any code model"
endchoice

choice
	prompt "Maximum Physical Memory"
	default MAXPHYSMEM_2GB if 32BIT
	default MAXPHYSMEM_2GB if 64BIT && CMODEL_MEDLOW
	default MAXPHYSMEM_128GB if 64BIT && CMODEL_MEDANY

	config MAXPHYSMEM_2GB
		bool "2GiB"
	config MAXPHYSMEM_128GB
		depends on 64BIT && CMODEL_MEDANY
		select MODULE_SECTIONS if MODULES
		bool "128GiB"
endchoice

config SMP
    bool "Symmetric multiprocessing"
    help
      Enable support for systems that have more than one processor.

config SMP_MAX_CPUS
    int "Max number of CPUs"
    depends on SMP
    default "8"
    help
      The default value is 8 CPUs.

config RISCV_ISA_C
	bool "Emit compressed instructions"
	default y

config RISCV_ISA_A
	def_bool y

endmenu
```

## arch/x86/config.in
```kconfig
#
# For a description of the syntax of this configuration file,
# see documentation/config/kconfig-language.txt.
#

config 64BIT
       bool "64-bit kernel" if ARCH = "x86_64"
       default SUBARCH = "x86_64"
    help
         Say yes to build a 64-bit kernel - formerly known as x86_64
         Say no to build a 32-bit kernel - formerly known as i386

config X86_32
       def_bool y
    depends on !64BIT

config X86_64
    def_bool y
    depends on 64BIT

source "kernel/config.in"

source "drivers/config.in"

menu "Power management and ACPI options"

source "drivers/acpi/config.in"

endmenu

menu "Processor type and features"

config X86_LOCAL_APIC
	def_bool y
	depends on SMP

config X86_IO_APIC
	def_bool y
	depends on SMP

config SMP
    bool "Symmetric multiprocessing"
    help
      Enable support for systems that have more than one processor.

config SMP_MAX_CPUS
    int "Max number of CPUs"
    depends on SMP
    default "8"
    help
      The default value is 8 CPUs.

endmenu
```

## config.in
```kconfig
#
# For a description of the syntax of this configuration file,
# see documentation/config/kconfig-language.txt.
#
mainmenu "Lyos/$SUBARCH $KERNELVERSION Kernel Configuration"

config ARCH
	string
	option env="ARCH"

config SUBARCH
	string
	option env="SUBARCH"

config KERNELVERSION
	string
	option env="KERNELVERSION"

source "arch/$ARCH/config.in"
```

## drivers/acpi/config.in
```kconfig
menuconfig ACPI
	bool "ACPI (Advanced Configuration and Power Interface) Support"
	default y
	help
	  Advanced Configuration and Power Interface (ACPI) support

if ACPI
endif
```

## drivers/block/config.in
```kconfig
#
# For a description of the syntax of this configuration file,
# see documentation/config/kconfig-language.txt.
#

menuconfig BLK_DEV
    bool "Block devices"
    default y
    ---help---
      Say Y here to get to see options for various different block device
      drivers. This option alone does not add any kernel code.

      If you say N, all options in this submenu will be skipped and disabled;
      only do this if you know what you are doing.

if BLK_DEV

config BLK_DEV_RAM_COUNT
    int "Default number of RAM disks"
    default "8"
    help
      The default value is 8 RAM disks.

config BLK_ATA_GENERIC
    tristate "Generic ATA support"
    default n
    help
      This option enables support for generic BIOS configured
      ATA controllers via the new ATA layer

      If unsure, say N.

source "drivers/block/virtio-blk/config.in"

source "drivers/block/nvme/config.in"

source "drivers/block/mmc/config.in"

endif
```

## drivers/block/mmc/config.in
```kconfig
menuconfig MMC
    tristate "MMC/SD/SDIO card support"
    help
      This selects MultiMediaCard, Secure Digital and Secure
      Digital I/O support.

      If you want MMC/SD/SDIO support, you should say Y here and
      also to your specific host controller driver.

if MMC

source "drivers/block/mmc/config.host.in"

endif
```

## drivers/block/nvme/config.in
```kconfig
#
# For a description of the syntax of this configuration file,
# see documentation/config/kconfig-language.txt.
#

config BLK_DEV_NVME
    bool "NVM Express block device"
    help
      The NVM Express driver is for solid state drives directly
      connected to the PCI or PCI Express bus.  If you know you
      don't have one of these, it is safe to answer N.
      To compile this driver as a module, choose M here: the
      module will be called nvme.
```

## drivers/block/virtio-blk/config.in
```kconfig
#
# For a description of the syntax of this configuration file,
# see documentation/config/kconfig-language.txt.
#

config VIRTIO_BLK
    bool "Virtio block driver"
    help
      This is the virtual block driver for virtio. It can be used with QEMU based VMMs (like KVM or Xen).
```

## drivers/clk/config.in
```kconfig
config HAVE_CLK
    bool

menuconfig COMMON_CLK
	bool "Common Clock Framework"
	select HAVE_CLK

if COMMON_CLK

config CLK_BCM2835
	bool "Broadcom BCM2835 clock support"
	depends on ARCH_BCM2835
	depends on COMMON_CLK
	default ARCH_BCM2835
	help
	  Enable common clock framework support for Broadcom BCM2835
	  SoCs.

endif
```

## drivers/config.in
```kconfig
#
# For a description of the syntax of this configuration file,
# see documentation/config/kconfig-language.txt.
#

menu "Device Drivers"

source "drivers/block/config.in"

source "drivers/hid/config.in"

source "drivers/pci/config.in"

source "drivers/video/config.in"

endmenu
```

## drivers/firmware/config.in
```kconfig
menuconfig FIRMWARE
	bool "Firmware"
	default y
	---help---
	  Say Y here to get to see options for various different firmware
	  drivers. This option alone does not add any kernel code.

	  If you say N, all options in this submenu will be skipped and disabled;
	  only do this if you know what you are doing.

if FIRMWARE

config FIRMWARE_DMI
	bool "Desktop Management Interface support"
	default y
	---help---
	  If you want to enable DMI, say Y.

endif
```

## drivers/gpu/drm/config.in
```kconfig
menuconfig DRM
    bool "Direct Rendering Manager (XFree86 4.1.0 and higher DRI support)"
    default y
    ---help---
      Kernel-level support for the Direct Rendering Infrastructure (DRI)
      introduced in XFree86 4.0.

if DRM

source "drivers/gpu/drm/virtio-gpu/config.in"

endif
```

## drivers/gpu/drm/virtio-gpu/config.in
```kconfig
#
# For a description of the syntax of this configuration file,
# see documentation/config/kconfig-language.txt.
#

config VIRTIO_GPU
    bool "Virtio GPU driver"
    help
      This is the virtual GPU driver for virtio.  It can be used with QEMU based VMMs (like KVM or Xen).
```

## drivers/hid/config.in
```kconfig
#
# For a description of the syntax of this configuration file,
# see documentation/config/kconfig-language.txt.
#

menuconfig HID_DEV
    bool "HID devices"
    default y
    ---help---
      Say Y here to get to see options for various different HID device
      drivers.

if HID_DEV

config KEYBOARD_ATKBD
    bool "AT keyboard"
    default y
    help
      Say Y here if you want to use a standard AT or PS/2 keyboard. Usually
      you'll need this, unless you have a different type keyboard (USB, ADB
      or other). This also works for AT and PS/2 keyboards connected over a
      PS/2 to serial converter.

      If unsure, say Y.

config USB_HID
    bool "USB HID transport layer"
    default y
    depends on USB
    help
      Say Y here if you want to connect USB keyboards,
      mice, joysticks, graphic tablets, or any other HID based devices
      to your computer via USB, as well as Uninterruptible Power Supply
      (UPS) and monitor control devices.

      If unsure, say Y.

endif
```

## drivers/hid/usbhid/config.in
```kconfig
menu "USB HID support"
    depends on USB
config USB_KBD
    tristate "USB HIDBP Keyboard (simple Boot) support"
    depends on USB
```

## drivers/net/config.in
```kconfig
menuconfig NETDEVICES
    default y
    depends on NET
    bool "Network device support"

if NETDEVICES

config VIRTIO_NET
    bool "Virtio network driver"
    depends on VIRTIO
    help
      This is the virtual network driver for virtio.  It can be used with
      QEMU based VMMs (like KVM or Xen).  Say Y or M.

endif
```

## drivers/pci/config.in
```kconfig
#
# For a description of the syntax of this configuration file,
# see documentation/config/kconfig-language.txt.
#

menuconfig PCI_DEV
	bool "PCI devices"
	default y
	---help---
	  Say Y here to get to see options for various different PCI device
	  drivers. This option alone does not add any kernel code.

	  If you say N, all options in this submenu will be skipped and disabled;
	  only do this if you know what you are doing.

if PCI_DEV

endif
```

## drivers/usb/config.in
```kconfig
menuconfig USB_SUPPORT
    bool "USB support"
    default y
    help
      This option adds core support for Universal Serial Bus (USB).
      You will also need drivers from the following menu to make use of it.

if USB_SUPPORT

config USB
    tristate "Support for Host-side USB"

source "drivers/usb/usbd/config.in"

endif # USB_SUPPORT
```

## drivers/video/config.in
```kconfig
#
# For a description of the syntax of this configuration file,
# see documentation/config/kconfig-language.txt.
#

menu "Graphics support"

source "drivers/gpu/drm/config.in"

endmenu
```

## kernel/arch/arm/mach-omap2/config.in
```kconfig
if ARCH_OMAP2PLUS

menu "TI OMAP2/3/4 Specific Features"

config ARCH_OMAP3
	bool "TI OMAP3"
	depends on ARCH_OMAP2PLUS
	default y

config MACH_OMAP3_BEAGLE
	bool "OMAP3 BEAGLE board"
	depends on ARCH_OMAP3
	default y

config MACH_TI_AM335X_EVM
	bool "TI AM335X EVM"
	depends on ARCH_OMAP3
	default y

endmenu

endif
```
