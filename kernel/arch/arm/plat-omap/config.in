## kernel/arch/arm/plat-omap/config.in
```kconfig
if ARCH_OMAP

menu "TI OMAP Common Features"

choice
	prompt "OMAP System Type"
	default ARCH_OMAP2PLUS

config ARCH_OMAP1
	bool "TI OMAP1"
	help
	  "Systems based on omap7xx, omap15xx or omap16xx"

config ARCH_OMAP2PLUS
	bool "TI OMAP2/3/4"
	help
	  "Systems based on OMAP2, OMAP3, OMAP4 or OMAP5"

endchoice

endmenu

endif
```

## kernel/arch/arm64/mach-bcm/config.in
```kconfig
menuconfig ARCH_BCM
    bool "Broadcom SoC Support"
    help
      This enables support for Broadcom ARM based SoC chips

if ARCH_BCM

config ARCH_BCM2835
    bool "Broadcom BCM2835 family"
    help
      This enables support for the Broadcom BCM2711 and BCM283x SoCs.
      This SoC is used in the Raspberry Pi and Roku 2 devices.

endif
```

## kernel/config.in
```kconfig
#
# For a description of the syntax of this configuration file,
# see documentation/config/kconfig-language.txt.
#

menu "General setup"

config LOCALVERSION
	string "Local version - append to kernel release"
	help
	  Append an extra string to the end of your kernel version.

config LOCALVERSION_AUTO
    bool "Automatically append version information to the version string"
    default y
    help
      Append git version information to the value set in CONFIG_LOCALVERSION.

choice
    prompt "Compression algorithm"
    default COMPRESS_NONE
    help
      What compress algorithm will be used to compress the kernel.

config COMPRESS_NONE
    bool "None"
    select COMPRESS_TYPE_NONE

config COMPRESS_GZIP
    bool "Gzip"
    select COMPRESS_TYPE_GZIP

endchoice
        
config DEFAULT_HOSTNAME
    string "Default hostname"
    default "(none)"
    help
      The default system hostname.

config LOG_BUF_SHIFT
    int "Kernel log buffer size (16 => 64KB, 17 => 128KB)"
    range 12 21
    default 14
    help
      Select kernel log buffer size as a power of 2.
      Examples:
            17 => 128 KB
            16 => 64 KB
            15 => 32 KB
            14 => 16 KB
            13 =>  8 KB
            12 =>  4 KB
            
endmenu

menu "Processor features"

config SMP
    bool "Symmetric multiprocessing"
    help
      Enable support for systems that have more than one processor.

config SMP_MAX_CPUS
    int "Max number of CPUs"
    depends on SMP
    default "8"
    help
      The default value is 8 CPUs.

endmenu

menu "Kernel hacking"

config DEBUG_KERNEL
    bool "Kernel debugging"
    help
      Enable kernel debugging.

config DEBUG_INFO
    bool "Compile the kernel with debug info"
    depends on DEBUG_KERNEL
    help
      Add debug info to the kernel.

endmenu
```

## lib/config.in
```kconfig
#
# For a description of the syntax of this configuration file,
# see documentation/config/kconfig-language.txt.
#

menu "Libraries"

source "lib/libof/config.in"

source "lib/libvirtio/config.in"

endmenu
```

## lib/libof/config.in
```kconfig
#
# For a description of the syntax of this configuration file,
# see documentation/config/kconfig-language.txt.
#

menuconfig OF
	bool "Device Tree and Open Firmware support"
	help
	  This option enables the device tree infrastructure.
	  It is automatically selected by platforms that need it or can
	  be enabled manually for unittests, overlays or
	  compile-coverage.
```

## lib/libvirtio/config.in
```kconfig
#
# For a description of the syntax of this configuration file,
# see documentation/config/kconfig-language.txt.
#

menuconfig VIRTIO
    bool "Virtio support"
    help
      This option is selected by any driver which implements the virtio bus.
```
